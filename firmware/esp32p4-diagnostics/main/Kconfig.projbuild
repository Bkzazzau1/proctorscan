## firmware/esp32p4-diagnostics/main/Kconfig.projbuild
```kconfig
menu "ProctorScan diagnostics"

config PROCTORSCAN_ADXL345_SIMULATOR
    bool "Emit simulated ADXL345 samples"
    default n
    help
        Emit clearly marked synthetic acceleration messages. This option does
        not configure I2C, GPIO, or access physical sensor hardware.

config PROCTORSCAN_ADXL345_PROBE
    bool "Probe a physical ADXL345 over I2C"
    default n
    depends on !PROCTORSCAN_ADXL345_SIMULATOR
    help
        Configure the Waveshare default I2C bus on GPIO7/GPIO8 and read only
        the ADXL345 device ID at address 0x53. No measurement mode is enabled.

endmenu
```
